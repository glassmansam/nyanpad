## boards/shields/nyanpad/Kconfig.defconfig
```kconfig
if SHIELD_NYANPAD

config ZMK_KEYBOARD_NAME
	default "Meowpad"

# bluetooth stuff 

config BT_MAX_CONN
    default 3

config BT_MAX_PAIRED
    default 3


endif
```
